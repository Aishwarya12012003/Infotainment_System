/*
 * MY_MCP2515.c
 *
 *  Created on: Nov 3, 2025
 *      Author: raghav
 */


#include "MY_SPI.h"
#include "MY_PIN.h"
#include "MY_MCP2515.h"
#include <stdio.h>


////MSG TX
//int MCP2515_TX_MSG(uint16_t id,uint8_t dlc,uint8_t *data)
//{
////	MCP2515_WRITE(CANCTRL,NORMAL);
//
////	if(MCP2515_READ(CANSTAT)==NORMAL)
////		{
////			printf("Hello");
////		}
////	else
////	{
////		printf("World");
////	}
//
////	if(MCP2515_READ(TXBnCTRL) & TXBnCTRL_TXREQ)
////	{
////		MCP2515_READ(TXBnCTRL);
////		MCP2515_WRITE(TXBnCTRL, NO_DATA);
////		MCP2515_READ(TXBnCTRL);
////		DelayMs(1);
//
//		// 1. Check if transmit buffer 0 is ready (TXREQ bit is low)
//		if (MCP2515_READ(TXBnCTRL) & TXBnCTRL_TXREQ) {
//			MCP2515_WRITE(TXBnCTRL,NO_DATA);
//			// Buffer is busy, return an error or wait
//			return 1;
//		}
//
//		MCP2515_WRITE(TXBnSIDH,(uint8_t)(id>>3));
//		MCP2515_READ(TXBnSIDH);
//
//		MCP2515_WRITE(TXBnSIDL,(uint8_t)(id<<5));
//		MCP2515_READ(TXBnSIDL);
//
//		MCP2515_READ(TXBnCTRL);
//
//		MCP2515_WRITE(TXBnDLC,dlc);
//		MCP2515_READ(TXBnDLC);
//
//		for(uint8_t i=0;i<dlc;i++)
//		{
//			MCP2515_WRITE(TXBnDm+i,data[i]);
//			MCP2515_READ(TXBnDm+i);
//		}
//
//		MCP2515_READ(TXBnCTRL);
//
//		MCP2515_RTS(SPI_RTS_0);
//
////
////		MCP2515_WRITE(TXBnCTRL, ~(TXBnCTRL_ABTF|TXBnCTRL_MLOA|TXBnCTRL_TXERR|TXBnCTRL_TXP0)|TXBnCTRL_TXP1|TXBnCTRL_TXREQ);
//		MCP2515_READ(TXBnCTRL);
////		DelayMs(1);
////
//		MCP2515_READ(CANINTF);
//		MCP2515_READ(CANSTAT);
//
//		while(!(MCP2515_READ(CANINTF)&CANINTF_TX0IF));
//		MCP2515_READ(CANINTF);
//
//		MCP2515_WRITE(CANINTF,MCP2515_READ(CANINTF)&CANINTF_RX0IF);
//		MCP2515_READ(CANINTF);
////
////		MCP2515_READ(TXBnCTRL);
////		DelayMs(1);
//		return 0;
////	}
//
//}



/////////////////////////////////////////////////////////////////////////////////////////////////////////////////////////////
/////////////////////////////////////////////////////////////////////////////////////////////////////////////////////////////
/////////////////////////////////////////////////////////////////////////////////////////////////////////////////////////////
/////////////////////////////////////////////////////////////////////////////////////////////////////////////////////////////
/////////////////////////////////////////////////////////////////////////////////////////////////////////////////////////////
/////////////////////////////////////////////////////////////////////////////////////////////////////////////////////////////
/////////////////////////////////////////////////////////////////////////////////////////////////////////////////////////////
/////////////////////////////////////////////////////////////////////////////////////////////////////////////////////////////
/////////////////////////////////////////////////////////////////////////////////////////////////////////////////////////////
/////////////////////////////////////////////////////////////////////////////////////////////////////////////////////////////
/////////////////////////////////////////////////////////////////////////////////////////////////////////////////////////////
/////////////////////////////////////////////////////////////////////////////////////////////////////////////////////////////
/////////////////////////////////////////////////////////////////////////////////////////////////////////////////////////////
/////////////////////////////////////////////////////////////////////////////////////////////////////////////////////////////

int MCP2515_TX_MSG(uint16_t id,uint8_t dlc,uint8_t *data)
{

	while(MCP2515_READ(TXBnCTRL) & TXBnCTRL_TXREQ);
	MCP2515_WRITE(TXBnCTRL,MCP2515_READ(TXBnCTRL) & ~(TXBnCTRL_ABTF|TXBnCTRL_MLOA|TXBnCTRL_TXERR));
	while( MCP2515_READ(TXBnCTRL)&TXBnCTRL_TXREQ || MCP2515_READ(CANCTRL)&CANCTRL_ABAT)
		return -1;
	MCP2515_READ(TXBnCTRL);

	MCP2515_WRITE(TXBnSIDH,(uint8_t)(id>>3));
	MCP2515_READ(TXBnSIDH);

	MCP2515_WRITE(TXBnSIDL,(uint8_t)(id<<5));
	MCP2515_READ(TXBnSIDL);

	MCP2515_READ(TXBnCTRL);

		MCP2515_WRITE(TXBnDLC,dlc);
		MCP2515_READ(TXBnDLC);

		for(uint8_t i=0;i<dlc;i++)
		{
			MCP2515_WRITE(TXBnDm+i,data[i]);
			MCP2515_READ(TXBnDm+i);
		}

		MCP2515_READ(TXBnCTRL);

		MCP2515_RTS(SPI_RTS_0);

//
//		MCP2515_WRITE(TXBnCTRL, ~(TXBnCTRL_ABTF|TXBnCTRL_MLOA|TXBnCTRL_TXERR|TXBnCTRL_TXP0)|TXBnCTRL_TXP1|TXBnCTRL_TXREQ);
		MCP2515_READ(TXBnCTRL);
//		DelayMs(1);
//
		MCP2515_READ(CANINTF);
		MCP2515_READ(CANSTAT);

		while(!(MCP2515_READ(CANINTF)&CANINTF_TX0IF));
		MCP2515_READ(CANINTF);

		MCP2515_WRITE(CANINTF,MCP2515_READ(CANINTF)&CANINTF_RX0IF);
		MCP2515_READ(CANINTF);
//
//		MCP2515_READ(TXBnCTRL);
//		DelayMs(1);
		return 0;
//	}

}


